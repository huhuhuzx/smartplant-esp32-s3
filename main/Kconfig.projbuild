## main/Kconfig.projbuild
```kconfig
menu "SmartPlant"

config SMARTPLANT_WIFI_SSID
    string "Initial Wi-Fi SSID"
    default ""
    help
        Used when no Wi-Fi credentials have been saved on the device.
        ESP32-S3 supports 2.4 GHz networks only.

config SMARTPLANT_WIFI_PASSWORD
    string "Initial Wi-Fi password"
    default ""
    help
        Initial credentials are stored in local sdkconfig and embedded in firmware.
        Once provisioned, Wi-Fi can be changed through the touchscreen or device website.

endmenu
```

## sdkconfig.defaults
```kconfig
CONFIG_IDF_TARGET="esp32s3"
CONFIG_ESPTOOLPY_FLASHSIZE_16MB=y
CONFIG_ESPTOOLPY_FLASHSIZE="16MB"
CONFIG_SPIRAM=y
CONFIG_SPIRAM_MODE_OCT=y
CONFIG_SPIRAM_SPEED_80M=y
CONFIG_SPIRAM_USE_MALLOC=y
CONFIG_SPIRAM_XIP_FROM_PSRAM=y
CONFIG_ESP32S3_DATA_CACHE_64KB=y
CONFIG_ESP32S3_DATA_CACHE_LINE_64B=y
CONFIG_BSP_LCD_SUB_BOARD_800_480=y
CONFIG_BSP_LCD_RGB_BUFFER_NUMS=2
CONFIG_BSP_LCD_RGB_BOUNCE_BUFFER_MODE=y
CONFIG_BSP_LCD_RGB_BOUNCE_BUFFER_HEIGHT=10
CONFIG_BSP_DISPLAY_LVGL_AVOID_TEAR=y
CONFIG_BSP_DISPLAY_LVGL_DIRECT_MODE=y
CONFIG_LV_FONT_MONTSERRAT_48=y
CONFIG_LV_FONT_MONTSERRAT_28=y
CONFIG_LV_USE_CHART=y
CONFIG_HTTPD_WS_SUPPORT=y
CONFIG_PARTITION_TABLE_CUSTOM=y
CONFIG_PARTITION_TABLE_CUSTOM_FILENAME="partitions.csv"
CONFIG_ESP_MAIN_TASK_STACK_SIZE=8192
CONFIG_ESP_CONSOLE_USB_SERIAL_JTAG=y
CONFIG_ESP_CONSOLE_SECONDARY_NONE=y
CONFIG_SMARTPLANT_WIFI_SSID=""
CONFIG_SMARTPLANT_WIFI_PASSWORD=""

CONFIG_LV_USE_FONT_COMPRESSED=y
CONFIG_LV_FONT_FMT_TXT_LARGE=y

CONFIG_LV_FONT_MONTSERRAT_20=y
```
